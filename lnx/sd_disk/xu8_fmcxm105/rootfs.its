## lnx/sd_disk/xu8_fmcxm105/rootfs.its
```
/dts-v1/;

/ {
    description = "U-Boot fitImage for XU8-zynqmp";
    #address-cells = <1>;

    images {
        kernel-1 {
            description = "Linux kernel";
            data = /incbin/("./build/Image.gz");
            type = "kernel";
            arch = "arm64";
            os = "linux";
            compression = "gzip";
            load = <0x80000>; // <0x200000>
            entry = <0x80000>;// <0x200000>
            hash-1 {
                algo = "sha256";
            };
        };
        fdt-1 {
            description = "Flattened Device Tree blob";
            data = /incbin/("./build/system.dtb");
            type = "flat_dt";
            arch = "arm64";
            compression = "none";
            hash-1 {
                algo = "sha256";
            };
        };
        ramdisk-1 {
            description = "petalinux-user-image";
            data = /incbin/("./rootfs.cpio.gz");
            type = "ramdisk";
            arch = "arm64";
            os = "linux";
            compression = "none";
            hash-1 {
                algo = "sha256";
            };
        };
    };

    configurations {
        default = "conf-1";
        conf-1 {
            description = "Boot Linux kernel, FDT blob";
            kernel = "kernel-1";
            fdt = "fdt-1";
            hash-1 {
                algo = "sha256";
            };
        };
        conf-2 {
            description = "Boot Linux kernel, FDT blob and ramdisk";
            kernel = "kernel-1";
            fdt = "fdt-1";
            ramdisk = "ramdisk-1";
            hash-1 {
                algo = "sha256";
            };
        };
    };
};
```
